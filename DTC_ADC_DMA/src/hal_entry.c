#include "hal_data.h"
#include "stdio.h"//引入printf的头文件
#if (1 == BSP_MULTICORE_PROJECT) && BSP_TZ_SECURE_BUILD
bsp_ipc_semaphore_handle_t g_core_start_semaphore =
{
    .semaphore_num = 0
};
#endif

// 全局变量（必须放在最前面！！！）
volatile bool uart_send_complete_flag = false;
fsp_err_t err = FSP_SUCCESS;

// 正确的串口回调函数（必须带参数！）
void user_uart_callback(uart_callback_args_t * p_args)
{
    if (p_args->event == UART_EVENT_TX_COMPLETE)
    {
        uart_send_complete_flag = true;
    }
}

uint16_t adc_result_buffer[4];
/* Callback function */
void adc_callback(adc_callback_args_t *p_args)
{
    /* TODO: add your own code here */
    if( p_args->event == ADC_EVENT_SCAN_COMPLETE )
    {
        err = R_DTC_Reset( &g_transfer0_ctrl,
                           (void*)&R_ADC0->ADDR[0],     // reset source address
                           &adc_result_buffer[0],       // reset destination address
                           1 );                         // reset block size
        if( FSP_SUCCESS != err )
        {
            __BKPT(1);
        }
    }
}






/*******************************************************************************************************************//**
 * main() is generated by the RA Configuration editor and is used to generate threads if an RTOS is used.  This function
 * is called by main() when no RTOS is used.
 **********************************************************************************************************************/
void hal_entry(void)
{
    /* TODO: add your own code here */
		//char debug_str[9];       // 用于格式化打印的缓冲区
		//debug_str[9]="111swdf";
    // 初始化串口
    g_uart7.p_api->open(g_uart7.p_ctrl, g_uart7.p_cfg);
    uint8_t msg[] = "100ask\r\n";
//		uint8_t mes1[]="adc0[1]_v=%f\n";
//		uint8_t mes2[]="adc0[2]_v=%f\n";
//		uint8_t mes3[]="adc0[3]_v=%f\n";
	char str[64];
	
    g_uart7.p_api->write(g_uart7.p_ctrl, msg, sizeof(msg)-1);
	 R_BSP_SoftwareDelay(10, BSP_DELAY_UNITS_MILLISECONDS); // 等待发完,否则只能100a
	
		adc_status_t adc_status;
	err=R_ADC_Open(&g_adc0_ctrl, &g_adc0_cfg);
	assert(FSP_SUCCESS==err);
	err=R_ADC_StatusGet(&g_adc0_ctrl, &adc_status);
	assert(FSP_SUCCESS==err);
	err=R_ADC_ScanCfg(&g_adc0_ctrl,&g_adc0_channel_cfg);
	
//	  .p_dest                                  = (void *) NULL,
//    .p_src                                   = (void const *) NULL,
			
		        g_transfer0_cfg.p_info->p_src = (void*)&R_ADC0->ADDR[0];
        // Destination is results buffer
        g_transfer0_cfg.p_info->p_dest = &adc_result_buffer[0];

	
	err = R_DTC_Open(&g_transfer0_ctrl,&g_transfer0_cfg);
	assert(FSP_SUCCESS == err);
	 /* Enable the DTC to handle incoming transfer requests. */
        err = R_DTC_Enable(&g_transfer0_ctrl);
        assert(FSP_SUCCESS == err);

 while(1)
       {
           /* In software trigger mode, start a scan by calling R_ADC_ScanStart(). In other modes, enable external
            * triggers by calling R_ADC_ScanStart(). */
           err = R_ADC_ScanStart(&g_adc0_ctrl);
           assert(FSP_SUCCESS == err);
//           printf("adc[0]_v=%f\n",(float)adc_result_buffer[0]/4095*3.3);
//           printf("adc[1]_v=%f\n",(float)adc_result_buffer[1]/4095*3.3);
//           printf("adc[2]_v=%f\n",(float)adc_result_buffer[3]/4095*3.3);
				         sprintf(str, "adc[0]_v=%f\n, adc[1]_v=%f\n, adc[2]_v=%f\n", 
                (float)adc_result_buffer[0]/4095*3.3, 
                (float)adc_result_buffer[1]/4095*3.3, 
                (float)adc_result_buffer[2]/4095*3.3);
				 //g_uart7.p_api->write(g_uart7.p_ctrl, msg, sizeof(msg)-1);
								g_uart7.p_api->write(g_uart7.p_ctrl, (uint8_t *)str, strlen(str));
           R_BSP_SoftwareDelay(1000, BSP_DELAY_UNITS_MILLISECONDS); // NOLINT100->160
       }

	
	  //g_uart7.p_api->write(g_uart7.p_ctrl, (uint8_t *)debug_str, strlen(debug_str));
    /* Wake up 2nd core if this is first core and we are inside a multicore project. */
#if (0 == _RA_CORE) && (1 == BSP_MULTICORE_PROJECT) && !BSP_TZ_NONSECURE_BUILD

#if BSP_TZ_SECURE_BUILD
    /* Take semaphore so 2nd core can clear it */
    R_BSP_IpcSemaphoreTake(&g_core_start_semaphore);
#endif

    R_BSP_SecondaryCoreStart();

#if BSP_TZ_SECURE_BUILD
    /* Wait for 2nd core to start and clear semaphore */
    while(FSP_ERR_IN_USE == R_BSP_IpcSemaphoreTake(&g_core_start_semaphore))
    {
        ;
    }
#endif
#endif

#if (1 == _RA_CORE) && (1 == BSP_MULTICORE_PROJECT) && BSP_TZ_SECURE_BUILD
    /* Signal to 1st core that 2nd core has started */
    R_BSP_IpcSemaphoreGive(&g_core_start_semaphore);
#endif


#if BSP_TZ_SECURE_BUILD
    /* Enter non-secure code */
    R_BSP_NonSecureEnter();
#endif
}

#if BSP_TZ_SECURE_BUILD

FSP_CPP_HEADER
BSP_CMSE_NONSECURE_ENTRY void template_nonsecure_callable ();

/* Trustzone Secure Projects require at least one nonsecure callable function in order to build (Remove this if it is not required to build). */
BSP_CMSE_NONSECURE_ENTRY void template_nonsecure_callable ()
{

}
FSP_CPP_FOOTER

#endif
