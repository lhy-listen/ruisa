#include "hal_data.h"
#include "stdio.h"//引入printf的头文件
#include "string.h"
#include "rainfall.h"
#include "uart2.h"
#include "adc0.h"
#include "adc_solidmoisture.h"
#include "pump.h"
#include "bh1750.h"
#include "i2c4.h"

#if (1 == BSP_MULTICORE_PROJECT) && BSP_TZ_SECURE_BUILD
bsp_ipc_semaphore_handle_t g_core_start_semaphore =
{
    .semaphore_num = 0
};
#endif
void sci_i2c4_master_callback(i2c_master_callback_args_t *p_args)
{
    // 空函数即可，不需要写内容
}

// 全局变量（必须放在最前面！！！）
volatile bool uart_send_complete_flag = false;
fsp_err_t err = FSP_SUCCESS;
fsp_err_t err1;//用于I2C4
// 用于存储 ADC 原始值的变量
uint16_t adc_data = 0;
// 用于存储换算后的电压值 (单位: V)
double adc_voltage = 0.0;
double humi=0.0;
// 用于ADC相关计算的结果值
float solidmositure_humidity=0.0;
float rainfall_humidity=0.0;
uint16_t rainfall_mode=0;
// 归一化处理


// 正确的串口回调函数（必须带参数！）
void user_uart2_callback(uart_callback_args_t * p_args)
{
    if (p_args->event == UART_EVENT_TX_COMPLETE)
    {
        uart_send_complete_flag = true;
    }
}

uint16_t adc_result_buffer[4];



/* Callback function */
void adc_callback(adc_callback_args_t *p_args)
{
    if (p_args->event == ADC_EVENT_SCAN_COMPLETE)
    {
        /**
         * 重点修复：R_DTC_Reset 的最后一个参数
         * 如果你采集 3 个通道（ADDR0, ADDR1, ADDR2），
         * 那么传输次数应该是 3，而不是 1。
         */
        err = R_DTC_Reset(&g_transfer0_ctrl,
                          (void*)&R_ADC0->ADDR[0],  // 源地址：ADC数据寄存器0
                          &adc_result_buffer[0],    // 目标地址：你的数组
                          4);                       // 【关键】传输次数必须与通道数一致！
        
        if (FSP_SUCCESS != err)
        {
            // 如果重置失败，不要用 __BKPT，可以先尝试忽略或者记录错误
            // __BKPT(1); 
        }

        /**
         * 如果你的 ADC 配置是 "Single Scan" (单次扫描)
         * 搬运完后需要手动再次启动，才能进行下一次采集。
         */
        R_ADC_ScanStart(&g_adc0_ctrl);
    }
}






/*******************************************************************************************************************//**
 * main() is generated by the RA Configuration editor and is used to generate threads if an RTOS is used.  This function
 * is called by main() when no RTOS is used.
 **********************************************************************************************************************/
void hal_entry(void)
{
	//归一化在这里
	float solid_handle1=(float)adc_result_buffer[1]/4095.0f;
	float solid_handle2=(float)adc_result_buffer[2]/4095.0f;
	float solid_handle3=(float)adc_result_buffer[3]/4095.0f;
	  char str[128];
		//水泵初始化
		Pump_Init();
		
	
		//UART2初始化
	  UART2_Init();
	
		//I2C4初始化
		I2C4_Init(err1);
	
		//光照传感器初始化
		BH1750_Init();
	
    // ADC 初始化
		ADC0_Init(err);

    // DTC 配置
		DTC_Init(&adc_result_buffer[0],err);
	
		

    // ===================== 只在这里启动一次！=====================
		adc0_Scan_Start(err);

		while(1)
		{
				uint16_t data_solidmoisture=adc_result_buffer[1];
				solidmositure_humidity=data_handle( data_solidmoisture);//土壤湿度
			
				uint16_t data_rainfall=adc_result_buffer[2];
			  rainfall_humidity=Get_Rainfall(data_rainfall);//雨滴
				
				float lux = BH1750_ReadLux();
			
				if(solidmositure_humidity<=20)
				{
					Pump_On();
					R_BSP_SoftwareDelay(3000, BSP_DELAY_UNITS_MILLISECONDS);//湿度低于20%，灌溉5s
					Pump_Off();
				}			
				int mode=rainfall_datahandle(data_rainfall);
				sprintf(str, "humi=%.3f%%\n rainfall=level%d\n Light = %.2f\r\n", 
				(float)solidmositure_humidity, 
				mode, 
				lux);
				//R_BSP_SoftwareDelay(100, BSP_DELAY_UNITS_MILLISECONDS);
				uart_send_complete_flag = false;
				err = g_uart2.p_api->write(g_uart2.p_ctrl, (uint8_t *)str, strlen(str));
/*以下是调试使用  */				
				// 如果这里卡死，说明 user_uart_callback 没进
//				uint32_t timeout = 0xFFFFFF; 
//				while(false == uart_send_complete_flag && timeout > 0) timeout--; 

//				if(timeout == 0) {
//						// 如果超时了，说明回调没工作，手动设为 true 看看能不能跑下一次
//						uart_send_complete_flag = true; 
//				}
				R_BSP_SoftwareDelay(500, BSP_DELAY_UNITS_MILLISECONDS);
		}
	
	  //g_uart7.p_api->write(g_uart7.p_ctrl, (uint8_t *)debug_str, strlen(debug_str));
    /* Wake up 2nd core if this is first core and we are inside a multicore project. */
#if (0 == _RA_CORE) && (1 == BSP_MULTICORE_PROJECT) && !BSP_TZ_NONSECURE_BUILD

#if BSP_TZ_SECURE_BUILD
    /* Take semaphore so 2nd core can clear it */
    R_BSP_IpcSemaphoreTake(&g_core_start_semaphore);
#endif

    R_BSP_SecondaryCoreStart();

#if BSP_TZ_SECURE_BUILD
    /* Wait for 2nd core to start and clear semaphore */
    while(FSP_ERR_IN_USE == R_BSP_IpcSemaphoreTake(&g_core_start_semaphore))
    {
        ;
    }
#endif
#endif

#if (1 == _RA_CORE) && (1 == BSP_MULTICORE_PROJECT) && BSP_TZ_SECURE_BUILD
    /* Signal to 1st core that 2nd core has started */
    R_BSP_IpcSemaphoreGive(&g_core_start_semaphore);
#endif


#if BSP_TZ_SECURE_BUILD
    /* Enter non-secure code */
    R_BSP_NonSecureEnter();
#endif
}

#if BSP_TZ_SECURE_BUILD

FSP_CPP_HEADER
BSP_CMSE_NONSECURE_ENTRY void template_nonsecure_callable ();

/* Trustzone Secure Projects require at least one nonsecure callable function in order to build (Remove this if it is not required to build). */
BSP_CMSE_NONSECURE_ENTRY void template_nonsecure_callable ()
{

}
FSP_CPP_FOOTER

#endif
