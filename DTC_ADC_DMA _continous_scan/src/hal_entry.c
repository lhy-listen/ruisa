#include "hal_data.h"
#include "stdio.h"//引入printf的头文件
#include "string.h"
#if (1 == BSP_MULTICORE_PROJECT) && BSP_TZ_SECURE_BUILD
bsp_ipc_semaphore_handle_t g_core_start_semaphore =
{
    .semaphore_num = 0
};
#endif

// 全局变量（必须放在最前面！！！）
volatile bool uart_send_complete_flag = false;
fsp_err_t err = FSP_SUCCESS;

// 正确的串口回调函数（必须带参数！）
void user_uart_callback(uart_callback_args_t * p_args)
{
    if (p_args->event == UART_EVENT_TX_COMPLETE)
    {
        uart_send_complete_flag = true;
    }
}

uint16_t adc_result_buffer[4];
/* Callback function */
void adc_callback(adc_callback_args_t *p_args)
{
    if (p_args->event == ADC_EVENT_SCAN_COMPLETE)
    {
        /**
         * 重点修复：R_DTC_Reset 的最后一个参数
         * 如果你采集 3 个通道（ADDR0, ADDR1, ADDR2），
         * 那么传输次数应该是 3，而不是 1。
         */
        err = R_DTC_Reset(&g_transfer0_ctrl,
                          (void*)&R_ADC0->ADDR[0],  // 源地址：ADC数据寄存器0
                          &adc_result_buffer[0],    // 目标地址：你的数组
                          4);                       // 【关键】传输次数必须与通道数一致！
        
        if (FSP_SUCCESS != err)
        {
            // 如果重置失败，不要用 __BKPT，可以先尝试忽略或者记录错误
            // __BKPT(1); 
        }

        /**
         * 如果你的 ADC 配置是 "Single Scan" (单次扫描)
         * 搬运完后需要手动再次启动，才能进行下一次采集。
         */
        R_ADC_ScanStart(&g_adc0_ctrl);
    }
}






/*******************************************************************************************************************//**
 * main() is generated by the RA Configuration editor and is used to generate threads if an RTOS is used.  This function
 * is called by main() when no RTOS is used.
 **********************************************************************************************************************/
void hal_entry(void)
{
    // 串口初始化 ...
    g_uart7.p_api->open(g_uart7.p_ctrl, g_uart7.p_cfg);
    uint8_t msg[] = "100ask\r\n";
	  uint8_t msg1[] = "100ast\r\n";
    char str[64];

    g_uart7.p_api->write(g_uart7.p_ctrl, msg, sizeof(msg)-1);
    R_BSP_SoftwareDelay(10, BSP_DELAY_UNITS_MILLISECONDS);

    // ADC 初始化
    adc_status_t adc_status;
    err=R_ADC_Open(&g_adc0_ctrl, &g_adc0_cfg);
    assert(FSP_SUCCESS==err);

    err=R_ADC_ScanCfg(&g_adc0_ctrl,&g_adc0_channel_cfg);
    assert(FSP_SUCCESS==err);

    // DTC 配置
    g_transfer0_cfg.p_info->p_src = (void*)&R_ADC0->ADDR[0];
    g_transfer0_cfg.p_info->p_dest = &adc_result_buffer[0];

    err = R_DTC_Open(&g_transfer0_ctrl,&g_transfer0_cfg);
    assert(FSP_SUCCESS == err);

    err = R_DTC_Enable(&g_transfer0_ctrl);
    assert(FSP_SUCCESS == err);

    // ===================== 只在这里启动一次！=====================
    err = R_ADC_ScanStart(&g_adc0_ctrl);
    assert(FSP_SUCCESS == err);

while(1)
{
//    // 改用最简单的整数打印，排除浮点数库崩溃可能
//    sprintf(str, "ADC Raw: %d, %d, %d\r\n", 
//            adc_result_buffer[0], 
//            adc_result_buffer[1], 
//            adc_result_buffer[2]);

				         sprintf(str, "adc[0]_v=%f\n, adc[1]_v=%f\n, adc[2]_v=%f\n", 
                (float)adc_result_buffer[1]/4095*3.3, 
                (float)adc_result_buffer[2]/4095*3.3, 
                (float)adc_result_buffer[3]/4095*3.3);
    uart_send_complete_flag = false;
    err = g_uart7.p_api->write(g_uart7.p_ctrl, (uint8_t *)str, strlen(str));
    
    // 如果这里卡死，说明 user_uart_callback 没进
    uint32_t timeout = 0xFFFFFF; 
    while(false == uart_send_complete_flag && timeout > 0) timeout--; 

    if(timeout == 0) {
        // 如果超时了，说明回调没工作，手动设为 true 看看能不能跑下一次
        uart_send_complete_flag = true; 
    }

    R_BSP_SoftwareDelay(500, BSP_DELAY_UNITS_MILLISECONDS);
}
	
	  //g_uart7.p_api->write(g_uart7.p_ctrl, (uint8_t *)debug_str, strlen(debug_str));
    /* Wake up 2nd core if this is first core and we are inside a multicore project. */
#if (0 == _RA_CORE) && (1 == BSP_MULTICORE_PROJECT) && !BSP_TZ_NONSECURE_BUILD

#if BSP_TZ_SECURE_BUILD
    /* Take semaphore so 2nd core can clear it */
    R_BSP_IpcSemaphoreTake(&g_core_start_semaphore);
#endif

    R_BSP_SecondaryCoreStart();

#if BSP_TZ_SECURE_BUILD
    /* Wait for 2nd core to start and clear semaphore */
    while(FSP_ERR_IN_USE == R_BSP_IpcSemaphoreTake(&g_core_start_semaphore))
    {
        ;
    }
#endif
#endif

#if (1 == _RA_CORE) && (1 == BSP_MULTICORE_PROJECT) && BSP_TZ_SECURE_BUILD
    /* Signal to 1st core that 2nd core has started */
    R_BSP_IpcSemaphoreGive(&g_core_start_semaphore);
#endif


#if BSP_TZ_SECURE_BUILD
    /* Enter non-secure code */
    R_BSP_NonSecureEnter();
#endif
}

#if BSP_TZ_SECURE_BUILD

FSP_CPP_HEADER
BSP_CMSE_NONSECURE_ENTRY void template_nonsecure_callable ();

/* Trustzone Secure Projects require at least one nonsecure callable function in order to build (Remove this if it is not required to build). */
BSP_CMSE_NONSECURE_ENTRY void template_nonsecure_callable ()
{

}
FSP_CPP_FOOTER

#endif
